/*
 * Cucu58 left half: pins as drawn by Ergogen (README.md > Wiring).
 * &pro_micro N is the pin printed "PN" / "N" on the Supermini / nice!nano footprint.
 */

#include "cucu58.dtsi"

&kscan0 {
    col-gpios
        = <&pro_micro 21 GPIO_ACTIVE_HIGH>   // outer
        , <&pro_micro 20 GPIO_ACTIVE_HIGH>   // pinky  + thumb_super
        , <&pro_micro 19 GPIO_ACTIVE_HIGH>   // ring   + thumb_inny
        , <&pro_micro 18 GPIO_ACTIVE_HIGH>   // middle + thumb_middy
        , <&pro_micro 15 GPIO_ACTIVE_HIGH>   // index  + thumb_reachy
        , <&pro_micro 14 GPIO_ACTIVE_HIGH>   // inner  + thumb_extra
        ;
    row-gpios
        = <&pro_micro 2 (GPIO_ACTIVE_HIGH | GPIO_PULL_DOWN)>   // num
        , <&pro_micro 3 (GPIO_ACTIVE_HIGH | GPIO_PULL_DOWN)>   // top
        , <&pro_micro 4 (GPIO_ACTIVE_HIGH | GPIO_PULL_DOWN)>   // home
        , <&pro_micro 5 (GPIO_ACTIVE_HIGH | GPIO_PULL_DOWN)>   // bottom
        , <&pro_micro 6 (GPIO_ACTIVE_HIGH | GPIO_PULL_DOWN)>   // thumb
        ;
};
